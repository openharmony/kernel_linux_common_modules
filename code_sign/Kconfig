## code_sign/Kconfig
```kconfig
# SPDX-License-Identifier: GPL-2.0-or-later
# Copyright (c) 2023 Huawei Device Co., Ltd.
#
config SECURITY_CODE_SIGN
	bool "Advanced code signing feature based on FS Verity"
	depends on FS_VERITY
	default n
	help
	  This option enables additional code signing verify features
	  based on fs-verity, including verify if a certificate's subject
	  and issuer can be trusted, etc.

	  If unsure, say N.
```

## container_escape_detection/Kconfig
```kconfig
# SPDX-License-Identifier: GPL-2.0-or-later
# Copyright (c) 2023 Huawei Device Co., Ltd.
#
config SECURITY_CONTAINER_ESCAPE_DETECTION
	bool "Enable container escape detection"
	default n
	depends on SECURITY_SELINUX
	help
	  Build support for container escape detection.
```

## dec/Kconfig
```kconfig
# SPDX-License-Identifier: GPL-2.0-or-later
# Copyright (c) 2024 Huawei Device Co., Ltd.
#
config SECURITY_DEC
	bool "Data enhance control features"

	depends on SECURITY_PATH
	default y
	help
	  This option enables file operation permission verification
	  at VFS layer.

	  If unsure, say N.

config SECURITY_DEC_DEVELOP
	bool "Enable Data enhance control develop mode"

	depends on SECURITY_DEC
	default y
	help
	  This option controls the operating mode of Data Enhance Control:
	  - If enabled (Y): DEC runs in DEVELOP mode.
	  - If disabled (N): DEC runs in PRODUCT mode, which enforces strict
			permission checks and log desensitization
```

## memory_security/Kconfig
```kconfig
# SPDX-License-Identifier: GPL-2.0-or-later
# Copyright (c) 2023 Huawei Device Co., Ltd.
#
# Config for hide excutable memory address of process manager
#

menu "Hide memory address manager"

config MEMORY_SECURITY
	default n
	bool "Enable memory protection for render process"
	help
	  Enable this to enable following two options.

config HIDE_MEM_ADDRESS
	default n
	bool "Hide excutable memory address in proc/[pid]/maps "
	depends on MEMORY_SECURITY
	help
	  Select show address about anonymous area of the process memory
	  with -rx- permissions or not.

config JIT_MEM_CONTROL
	default n
	bool "Enable memory protection for Just-In-Time compiler's codespace"
	depends on MEMORY_SECURITY
	help
	  Restrict mmap and mprotect interface for process which use JIT compiler.
endmenu
# a blank line must be existed
```

## newip/src/linux-5.10/net/newip/Kconfig
```kconfig
# SPDX-License-Identifier: GPL-2.0
# Copyright (c) 2022 Huawei Device Co., Ltd.
#

# net/newip/Kconfig
config NEWIP
	def_bool $(success,$(srctree)/scripts/ohos-check-dir.sh $(srctree)/net/newip)
	depends on INET && NET
	help
	  Support for NewIP.

config NEWIP_FAST_KEEPALIVE
	bool "NewIP fast keepalive"
	default n
	depends on NEWIP
	help
	  Support for NewIP fast keepalive.

config NEWIP_HOOKS
	def_bool NEWIP && HCK_VENDOR_HOOKS
	help
	  Enable NewIP hooks implemented as tracepoints
	  Allow NewIP modules to attach to tracepoint "hooks" defined via
	  DECLARE_TRACE or DECLARE_HOOK
```

## ucollection/Kconfig
```kconfig
# SPDX-License-Identifier: GPL-2.0
config UNIFIED_COLLECTION
	def_bool $(success,$(srctree)/scripts/ohos-check-dir.sh $(srctree)/drivers/staging/ucollection)
	tristate "Enable unified collection"
	help
	  unified collection
```

## xpm/Kconfig
```kconfig
# SPDX-License-Identifier: GPL-2.0-or-later
# Copyright (c) 2023 Huawei Device Co., Ltd.
#
# Config for the excutable permission manager
#

menu "Executable permission manager"

config SECURITY_XPM
	def_bool $(success, $(srctree)/scripts/ohos-check-dir.sh $(srctree)/security/xpm)
	depends on 64BIT
	help
	  The Executable Permission Manager(XPM) control process execution
	  by inserting control poliy into the security hook list, such as execv,
	  mmap and etc. It can control not to execute an illegal signature
	  process.

config SECURITY_XPM_DEBUG
	bool "Enables excutable permission manager debug mode"
	depends on SECURITY_XPM
	default n
	help
	  This option should only be enabled for debug test which can enable
	  some debug interfaces to obtain detailed information.
endmenu
# a blank line must be existed
```
